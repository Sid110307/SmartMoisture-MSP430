#include "./include/oled.h"

static const uint8_t font5x7[][5] = {
	{0x00, 0x00, 0x00, 0x00, 0x00}, // 0x20 ' '
	{0x00, 0x00, 0x5F, 0x00, 0x00}, // 0x21 '!'
	{0x00, 0x07, 0x00, 0x07, 0x00}, // 0x22 '"'
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	{0x08, 0x04, 0x08, 0x10, 0x08}, // 0x7E '~'
};

static uint8_t fontIndexForChar(const char c)
{
	if ((unsigned char)c < 0x20 || (unsigned char)c > 0x7E) return 0;
	return (uint8_t)((unsigned char)c - 0x20);
}

static void i2cInit(void)
{
	P1SEL0 |= BIT2 | BIT3;
	P1SEL1 &= ~(BIT2 | BIT3);

	UCB0CTLW0 = UCSWRST;
	UCB0CTLW0 |= UCMST | UCMODE_3 | UCSYNC;
	UCB0CTLW0 |= UCSSEL__SMCLK;

	UCB0BRW = 10;
	UCB0I2CSA = OLED_ADDR;
	UCB0CTLW0 &= ~UCSWRST;
}

static void i2cWriteBytes(const uint8_t control, const uint8_t* data, const uint16_t len)
{
	while (UCB0STATW & UCBBUSY);
	UCB0CTLW0 |= UCTR | UCTXSTT;
	while (!(UCB0IFG & UCTXIFG0));
	UCB0TXBUF = control;

	for (uint16_t i = 0; i < len; ++i)
	{
		while (!(UCB0IFG & UCTXIFG0));
		UCB0TXBUF = data[i];
	}

	while (!(UCB0IFG & UCTXIFG0));
	UCB0CTLW0 |= UCTXSTP;
	while (UCB0CTLW0 & UCTXSTP);
}

static void oledSendCommand(const uint8_t cmd)
{
	const uint8_t b = cmd;
	i2cWriteBytes(0x00, &b, 1);
}

static void oledSendData(const uint8_t data)
{
	const uint8_t b = data;
	i2cWriteBytes(0x40, &b, 1);
}

static void oledSetCursor(const uint8_t col, const uint8_t page)
{
	oledSendCommand(0x21);
	oledSendCommand(col);
	oledSendCommand(0x7F);

	oledSendCommand(0x22);
	oledSendCommand(page);
	oledSendCommand(0x07);
}

static void oledDrawChar(const uint8_t col, const uint8_t page, const char c)
{
	const uint8_t idx = fontIndexForChar(c);
	const uint8_t* glyph = font5x7[idx];

	oledSetCursor(col, page);
	for (uint8_t i = 0; i < 5; ++i) oledSendData(glyph[i]);
	oledSendData(0x00);
}

void oledInit(void)
{
	i2cInit();
	delayCyclesUl(BLE_FAULT_BLINK_DELAY);

	oledSendCommand(0xAE);
	oledSendCommand(0xD5);
	oledSendCommand(0x80);
	oledSendCommand(0xA8);
	oledSendCommand(0x3F);
	oledSendCommand(0xD3);
	oledSendCommand(0x00);
	oledSendCommand(0x40);
	oledSendCommand(0x8D);
	oledSendCommand(0x14);
	oledSendCommand(0x20);
	oledSendCommand(0x00);
	oledSendCommand(0xA1);
	oledSendCommand(0xC8);
	oledSendCommand(0xDA);
	oledSendCommand(0x12);
	oledSendCommand(0x81);
	oledSendCommand(0xCF);
	oledSendCommand(0xD9);
	oledSendCommand(0xF1);
	oledSendCommand(0xDB);
	oledSendCommand(0x40);
	oledSendCommand(0xA4);
	oledSendCommand(0xA6);
	oledSendCommand(0x2E);
	oledSendCommand(0xAF);
}

void oledClear(void)
{
	oledSetCursor(0, 0);
	for (uint16_t i = 0; i < 1024; ++i) oledSendData(0x00);
}

void oledDrawString(const uint8_t col, const uint8_t page, const char* s)
{
	uint8_t x = col;
	while (*s && x < 128)
	{
		oledDrawChar(x, page, *s++);
		x += 6;
	}
}
